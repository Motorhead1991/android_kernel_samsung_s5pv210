## drivers/net/wireless/bcm4329/Kconfig
```kconfig
config BROADCOM_4329
	default n
	tristate "Broadcom WiFi 4329"
	---help---
		Select this option to build Broadcom wlan driver

config BROADCOM_WIFI_RESERVED_MEM
    bool "Samsung Multimedia Devices"
    depends on BROADCOM_WIFI
    default n
    ---help---
      This is a configuration for broadcom WLAN driver.

if BROADCOM_WIFI_RESERVED_MEM
config WLAN_SAMSUNG_MEMSIZE_BCM
    int "Memory size in kbytes for WLAN driver"
    default "256"
endif
```

## drivers/net/wireless/bcm4330/Kconfig
```kconfig
config BROADCOM_WIFI
	default n
	tristate "Broadcom WiFi"
	---help---
		Select this option to build Broadcom wlan driver for the 4330 chip
#config BCM_EMBED_FW
#	default n
#	bool "Broadcom Embed FW into WiFi Driver"
#	depends on BROADCOM_WIFI != n
#	---help---
#		Select this option to embed firmware into wlan driver
```
